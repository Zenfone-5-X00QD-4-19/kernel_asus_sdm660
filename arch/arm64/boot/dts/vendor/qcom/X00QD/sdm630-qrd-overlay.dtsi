/* SPDX-License-Identifier: GPL-2.0 */

&qrd_batterydata {
	#include "fg-gen3-batterydata-coslight-C11P1708-3150mah_4p35v.dtsi"
	#include "fg-gen3-batterydata-qrd-skuk-4v4-3000mah.dtsi"
};

&pm660_fg {
	qcom,battery-data = <&qrd_batterydata>;
	qcom,fg-jeita-thresholds = <0 10 50 60>;
	qcom,battery-thermal-coefficients = [9d 50 ff];
	qcom,fg-cutoff-voltage = <3400>; //ASUS BSP : LiJen Battery
	qcom,fg-empty-voltage = <2800>; //ASUS BSP : LiJen Battery
	qcom,fg-cutoff-current = <100>; //ASUS BSP : LiJen fine tune msoc for low temperature 
	qcom,fg-esr-tight-filter-micro-pct = <20000>; //ASUS BSP : LiJen Battery
	qcom,fg-esr-broad-filter-micro-pct = <25000>; //ASUS BSP : LiJen Battery
	qcom,fg-esr-tight-lt-filter-micro-pct = <2000>; //ASUS BSP : LiJen Battery
	qcom,fg-esr-broad-lt-filter-micro-pct = <2200>; //ASUS BSP : LiJen Battery
	qcom,slope-limit-coeffs = <1 1 1 1>; //ASUS BSP : LiJen Battery
};

&sdhc_1 {
    qcom,vdd-always-on;
};

&sdhc_2 {
	qcom,vdd-voltage-level = <3300000 3300000>;
};
